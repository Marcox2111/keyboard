## config/boards/shields/caldera/Kconfig.defconfig
```kconfig
CONFIG_PINCTRL=y

if SHIELD_CALDERA_LEFT

    config ZMK_KEYBOARD_NAME
        default "Caldera"

    config ZMK_SPLIT_ROLE_CENTRAL
        default y

    config ZMK_SPLIT_BLE_CENTRAL_PERIPHERALS
        default 2
        

    if ZMK_DISPLAY
        config ZMK_DISPLAY_STATUS_SCREEN_CUSTOM
            select ZMK_WPM
    endif

endif

if SHIELD_CALDERA_LEFT || SHIELD_CALDERA_RIGHT

    config ZMK_SPLIT
        default y

    if ZMK_DISPLAY
        config ZMK_DISPLAY_STATUS_SCREEN_CUSTOM
        select LV_USE_LABEL
        select LV_USE_IMG
        select LV_USE_CANVAS
        select LV_USE_ANIMIMG
        select LV_USE_ANIMATION
        select LV_USE_LINE
        select LV_FONT_UNSCII_8

    config I2C
        default y

    config SSD1306
        default y

endif # ZMK_DISPLAY

    if LVGL

    config LV_Z_MEM_POOL_SIZE
        default 8192

    config LV_Z_VDB_SIZE
        default 64

    config LV_Z_DPI_DEF
        int "LVGL DPI value"
        default 148

    config LV_Z_BITS_PER_PIXEL
        default 1

    choice LV_COLOR_DEPTH
        default LV_COLOR_DEPTH_1
    endchoice

endif # LVGL

endif # SHIELD_CALDERA_LEFT || SHIELD_CALDERA_RIGHT
```
